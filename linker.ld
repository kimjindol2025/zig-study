/* ============================================================================
   커널 링커 스크립트 (Kernel Linker Script)

   이 스크립트는 커널 코드가 메모리의 어느 주소에 배치될지를 결정합니다.
   부트로더와 협력하여 커널을 정확한 위치에 로드합니다.

   기본 메모리 맵 (x86_64):
   0x00000000 - 0x00000400: IVT (Interrupt Vector Table) - 레거시
   0x00000400 - 0x00000500: BDA (BIOS Data Area)
   0x00007C00 - 0x00007E00: 부트로더 (MBR)
   0x00100000 (1MB):        커널 시작 지점 ← 우리의 커널
   0x400000 (4MB):          페이징 가능한 영역 시작

   ============================================================================ */

/* 메모리 영역 정의 */
MEMORY
{
    /* RAM 영역 (512MB 가정) */
    ram (rwx) : ORIGIN = 0x100000, LENGTH = 0x20000000
}

/* 섹션 정의 */
SECTIONS
{
    /* 커널이 시작되는 가상 주소 */
    . = 0x100000;

    /* 섹션 시작 주소를 기록 */
    kernel_start = .;

    /* .text 섹션: 프로그램 코드 */
    .text ALIGN(0x1000) :
    {
        *(.text)
        *(.text.*)
    } :text

    /* .rodata 섹션: 읽기 전용 데이터 (상수) */
    .rodata ALIGN(0x1000) :
    {
        *(.rodata)
        *(.rodata.*)
    }

    /* .data 섹션: 초기화된 데이터 */
    .data ALIGN(0x1000) :
    {
        *(.data)
        *(.data.*)
    }

    /* .bss 섹션: 초기화되지 않은 데이터 (0으로 채움) */
    .bss ALIGN(0x1000) :
    {
        *(COMMON)
        *(.bss)
        *(.bss.*)
    }

    /* 커널이 끝나는 가상 주소 */
    kernel_end = .;

    /* 디버그 정보 (선택사항) */
    /DISCARD/ :
    {
        *(.note.GNU-stack)
        *(.gnu_debuglink)
        *(.gnu.lto_*)
    }
}

/* 진입점 정의 */
ENTRY(_start)
